## customfeed/utils/hello/Config.in
```kconfig
#
# Copyright (C) 2010-2012 OpenWrt.org
#
# This is free software, licensed under the GNU General Public License v2.
# See /LICENSE for more information.
#

menu "Configuration"
        depends on PACKAGE_hello

config HELLO_FOO
        bool
        prompt "HELLO_FOO"
        default y

endmenu
```
